## CMakeLists.txt
```
cmake_minimum_required(VERSION 3.13.1)

find_package(Zephyr REQUIRED HINTS $ENV{ZEPHYR_BASE})
project(second_example_app)

FILE(GLOB app_sources src/*.c)
target_sources(app PRIVATE ${app_sources})

target_include_directories(app PRIVATE inc)
```

## prj.conf
```kconfig
CONFIG_GPIO=y
CONFIG_STDOUT_CONSOLE=y
# enable to use thread names
#CONFIG_THREAD_NAME=y

CONFIG_UART_CONSOLE=n
CONFIG_USE_SEGGER_RTT=y
CONFIG_RTT_CONSOLE=y

# CONFIG_NRFX_GPIOTE=y
# CONFIG_NRFX_DPPI=y
```

## src/main.c
```c
/**
 * @file main.c
 *
 * In this example, ISR handling in Zephyr is explored.
 *
 * An ISR is triggered when button 1 or button 2 on the board is pressed. When
 * this ISR is triggered, it will mock a sensor reading, and then signal to the
 * "data processing" thread that the data is ready to process. The signaling
 * will be done with a semaphore and the data will be put/retrieved in a stack.
 * Further more, one thread A has higher priority than the other. Give that both
 * threads are pre-emptable, thread A can take over while thread B is processing
 * if button 1 shortly after button 2 is pressed (while thread B is processing
 * data).
 *
 * The ISR that triggers thread A, does the (mock) sensor data measurement in
 * the ISR code since this sensor needs time to make a measurement. The ISR that
 * triggers thread B is a sensor that does not rely on time to get an accurate
 * measurement. Therefore, the thread can start the trigger measuring process.
 *
 * TODO: Mock something for thread B to process.
 *
 */

/*======= Includes ==========================================================*/

#include "app_gpio.h"
#include <inttypes.h>
#include <sys/printk.h>
#include <zephyr.h>

/*======= Local Macro Definitions ===========================================*/

#define STACK_SIZE 1024

#define PRIORITY_A 1
#define PRIORITY_B 2

#define ONE_SECOND_US 1000000

/*======= Type Definitions ==================================================*/
/*======= Local function prototypes =========================================*/

void button1PressedIsr(struct device *       port,
                       struct gpio_callback *cb,
                       gpio_port_pins_t      pins);

void button2PressedIsr(struct device *       port,
                       struct gpio_callback *cb,
                       gpio_port_pins_t      pins);

/*======= Local variable declarations =======================================*/

/*======= Thread prototypes =================================================*/

void processingThreadA(void *dummy1, void *dummy2, void *dummy3);
void processingThreadB(void *dummy1, void *dummy2, void *dummy3);

/*======= Kernal Services Initialization ====================================*/

K_THREAD_DEFINE(dataHandlerA,
                STACK_SIZE,
                processingThreadA,
                NULL,
                NULL,
                NULL,
                PRIORITY_A,
                0,
                0);

K_THREAD_DEFINE(dataHandlerB,
                STACK_SIZE,
                processingThreadB,
                NULL,
                NULL,
                NULL,
                PRIORITY_B,
                0,
                0);

K_SEM_DEFINE(dataHandler1Sem, 0, 1);
K_SEM_DEFINE(dataHandler2Sem, 0, 1);

K_STACK_DEFINE(mockDataA, 3);
K_STACK_DEFINE(mockDataB, 2);

/*======= Global function implementations ===================================*/
/*======= Local function implementations ====================================*/

void button1PressedIsr(struct device *       port,
                       struct gpio_callback *cb,
                       gpio_port_pins_t      pins)
{
    printk("Button 1 was pressed!\r\n");

    u8_t mockTemp     = 13;
    u8_t mockHumdity  = 30;
    u8_t mockPressure = 250;

    int status = 0;
    status |= k_stack_push(&mockDataA, (stack_data_t)&mockTemp);
    status |= k_stack_push(&mockDataA, (stack_data_t)&mockHumdity);
    status |= k_stack_push(&mockDataA, (stack_data_t)&mockPressure);
    if (status != 0) {
        printk("A Stack operation failed");
        return;
    }

    printk("Measurement 1 done!\r\n");
    k_sem_give(&dataHandler1Sem);
}

void button2PressedIsr(struct device *       port,
                       struct gpio_callback *cb,
                       gpio_port_pins_t      pins)
{
    printk("Button 2 was pressed!\r\n");
    k_busy_wait(ONE_SECOND_US * 4);
    printk("Measurement 2 done!\r\n");
    k_sem_give(&dataHandler2Sem);
}

/*======= Thread implementations ============================================*/

void processingThreadA(void *dummy1, void *dummy2, void *dummy3)
{
    initButtonAsInterrupt(0, button1PressedIsr);
    u8_t *mockTemp;
    u8_t *mockHumdity;
    u8_t *mockPressure;
    while (1) {
        k_sem_take(&dataHandler1Sem, K_FOREVER);
        printk("Starting processing of Measurement 1 data \r\n");

        int status;
        status |= k_stack_pop(&mockDataA, (stack_data_t *)&mockPressure, K_FOREVER);
        status |= k_stack_pop(&mockDataA, (stack_data_t *)&mockHumdity, K_FOREVER);
        status |= k_stack_pop(&mockDataA, (stack_data_t *)&mockTemp, K_FOREVER);
        if (status != 0) {
            printk("A Stack operation failed");
            return;
        }

        printk("mockTemperature: %d\r\n", *mockTemp);
        printk("mockHumdity: %d\r\n", *mockHumdity);
        printk("mockPressure: %d\r\n", *mockPressure);

        k_busy_wait(ONE_SECOND_US * 2);
        printk("Finished processing of Measurement 1 data \r\n");
    }
}

void processingThreadB(void *dummy1, void *dummy2, void *dummy3)
{
    initButtonAsInterrupt(1, button2PressedIsr);
    while (1) {
        k_sem_take(&dataHandler2Sem, K_FOREVER);
        printk("Hello world from B!\r\n");
        k_busy_wait(4000000);
        printk("Finished processing in B\r\n");
    }
}
```

## inc/app_gpio.h
```c
#ifndef _app_gpio_H_
#define _app_gpio_H_

#ifdef __cplusplus
extern "C" {
#endif

/**
 * @file app_gpio.h
 *
 * Description
 *
 */

/*======= Includes ==========================================================*/

#include <drivers/gpio.h>
#include <inttypes.h>

/*======= Public macro definitions ==========================================*/
/*======= Type Definitions and declarations =================================*/
/*======= Public variable declarations ======================================*/
/*======= Public function declarations ======================================*/

void initButtonAsInterrupt(u8_t                    buttonNumber,
                           gpio_callback_handler_t buttonIsr);

#ifdef __cplusplus
}
#endif

#endif /* _app_gpio_H_ */
```

## src/app_gpio.c
```c
/**
 * @file app_gpio.c
 *
 * Description
 *
 */

/*======= Includes ==========================================================*/

#include "app_gpio.h"

/*======= Local Macro Definitions ===========================================*/

#define FLAGS_OR_ZERO(node)						\
	COND_CODE_1(DT_PHA_HAS_CELL(node, gpios, flags),		\
		    (DT_GPIO_FLAGS(node, gpios)),			\
		    (0))

#define SW0_NODE	DT_ALIAS(sw0)
#define SW1_NODE	DT_ALIAS(sw1)

#if DT_NODE_HAS_STATUS(SW0_NODE, okay)
#define SW0_GPIO_LABEL	DT_GPIO_LABEL(SW0_NODE, gpios)
#define SW0_GPIO_PIN	DT_GPIO_PIN(SW0_NODE, gpios)
#define SW0_GPIO_FLAGS	(GPIO_INPUT | FLAGS_OR_ZERO(SW0_NODE))
#define SW1_GPIO_LABEL	DT_GPIO_LABEL(SW1_NODE, gpios)
#define SW1_GPIO_PIN	DT_GPIO_PIN(SW1_NODE, gpios)
#define SW1_GPIO_FLAGS	(GPIO_INPUT | FLAGS_OR_ZERO(SW1_NODE))
#else
#error "Unsupported board: sw0 devicetree alias is not defined"
#endif

/*======= Type Definitions ==================================================*/
/*======= Local function prototypes =========================================*/
/*======= Local variable declarations =======================================*/

static struct device *button_device[2];

/*======= Thread prototypes =================================================*/
/*======= Kernal Services Initialization ====================================*/
/*======= Global function implementations ===================================*/

void initButtonAsInterrupt(u8_t buttonNumber, gpio_callback_handler_t buttonIsr)
{
    static struct gpio_callback button_cb[2];

    if (buttonNumber > 1) {
        return;
    }

    gpio_pin_t   pin;
    gpio_flags_t flags;
    char *       device;
    switch (buttonNumber) {
    case 0:
        pin    = (gpio_pin_t)SW0_GPIO_PIN;
        flags  = (gpio_flags_t)SW0_GPIO_FLAGS;
        device = (char *)SW0_GPIO_LABEL;
        break;
    case 1:
        pin    = (gpio_pin_t)SW1_GPIO_PIN;
        flags  = (gpio_flags_t)SW1_GPIO_FLAGS;
        device = (char *)SW1_GPIO_LABEL;
        break;

    default:
        return;
        break;
    }

    button_device[buttonNumber] = device_get_binding(device);
    gpio_pin_configure(button_device[buttonNumber],
                       pin,
                       GPIO_INPUT | GPIO_INT_DEBOUNCE | flags);
    gpio_pin_interrupt_configure(button_device[buttonNumber],
                                 pin,
                                 GPIO_INT_EDGE_TO_ACTIVE);
    gpio_init_callback(&button_cb[buttonNumber], buttonIsr, BIT(pin));
    gpio_add_callback(button_device[buttonNumber], &button_cb[buttonNumber]);
}

/*======= Local function implementations ====================================*/
/*======= Thread implementations ============================================*/
```
